
&pm6150l_lcdb {
    /delete-property/ qcom,voltage-step-ramp;
};

&flash_led {
    pm6150l_flashlight: qcom,flashlight {
	label = "flash";
	qcom,led-name = "flashlight";
	qcom,max-current = <750>;
	qcom,default-led-trigger = "flashlight_trigger";
	qcom,id = <3>;
	qcom,current-ma = <500>;
	qcom,duration-ms = <1280>;
	qcom,ires-ua = <12500>;
	qcom,hdrm-voltage-mv = <325>;
	qcom,hdrm-vol-hi-lo-win-mv = <100>;
    };
};
