#include "../common/sm7150-xiaomi-qrd.dtsi"
#include "../common/sm7150-xiaomi-common.dtsi"
#include "../common/sm7150-xiaomi-nfc.dtsi"

#include "sm7150-davinci-qrd.dtsi"
#include "sm7150-davinci-qupv3.dtsi"

#include "sm7150-davinci-audio.dtsi"
#include "sm7150-davinci-camera-sensor-qrd.dtsi"
#include "sm7150-davinci-fingerprint-goodix.dtsi"
#include "sm7150-davinci-motor.dtsi"
#include "sm7150-davinci-sde-display.dtsi"
#include "sm7150-davinci-thermal.dtsi"
#include "sm7150-davinci-touchscreen-goodix.dtsi"
#include "sm7150-davinci-usb.dtsi"

&firmware {
  android {
    fstab {
      product {
        compatible = "android,product";
        dev = "/dev/block/platform/soc/1d84000.ufshc/by-name/cust";
        type = "ext4";
        mnt_flags = "ro,noatime,nodev,barrier=1";
        fsmgr_flags = "wait";
      };
    };
  };
};
