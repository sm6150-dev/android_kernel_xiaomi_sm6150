&mi_touch {
  status = "ok";
};

&gt9886 {
  status = "ok";
  goodix,avdd-gpio = <&tlmm 5 0x0>;           /* 1v8 */
  goodix,cfg-name = "goodix_gt9886_cfg_f10.bin";
  sensor0 {
        goodix,limit-name = "goodix_gt9886_limit_f10_second.tporder";
        goodix,fw-name = "goodix_gt9886_fw_f10.bin";
        goodix,x2x;
        goodix,y2y;
  };
  sensor1 {
        goodix,limit-name = "goodix_gt9886_limit_f10_first.tporder";
        goodix,fw-name = "goodix_gt9886_fw_f10.bin";
  };
};
